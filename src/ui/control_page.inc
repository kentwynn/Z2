const char kControlPage[] PROGMEM = R"HTML(
<!doctype html>
<html lang="en">
<head>
<meta charset="utf-8">
<meta name="viewport" content="width=device-width,initial-scale=1,viewport-fit=cover">
<meta name="theme-color" content="#050505">
<title>zautobot local system</title>
<style>
:root{color-scheme:dark;--bg:#050505;--surface:#0d0d0d;--raised:#151515;--line:#2a2a2a;--text:#fff;--muted:#8b8b8b;--inverse:#000}
[data-theme="light"]{color-scheme:light;--bg:#f7f7f5;--surface:#fff;--raised:#ececea;--line:#cacac6;--text:#050505;--muted:#666662;--inverse:#fff}
*{box-sizing:border-box}html{background:var(--bg);scroll-behavior:smooth}body{margin:0;background:var(--bg);color:var(--text);font-family:ui-monospace,SFMono-Regular,"SF Mono",Menlo,Consolas,monospace;-webkit-font-smoothing:antialiased}button,input{font:inherit}button,a{color:inherit}.page{width:min(1240px,100%);margin:auto;padding:0 28px 40px}.nav{height:76px;display:flex;align-items:center;justify-content:space-between;border-bottom:1px solid var(--line)}.wordmark{font:900 18px/1 Arial,sans-serif;letter-spacing:-.08em}.nav-right{display:flex;align-items:center;gap:8px}.nav-link,.icon-button{height:38px;border:1px solid var(--line);background:transparent;text-decoration:none;display:inline-grid;place-items:center;font-size:10px;font-weight:700;letter-spacing:.08em}.nav-link{padding:0 15px}.icon-button{width:38px;cursor:pointer}.nav-link:hover,.icon-button:hover,.button:hover{background:var(--text);color:var(--inverse);border-color:var(--text)}
.hero{min-height:360px;padding:64px 0 40px;display:grid;grid-template-columns:minmax(0,1fr) 340px;gap:60px;align-items:end}.overline,.section-index,.label{color:var(--muted);font-size:9px;letter-spacing:.16em;text-transform:uppercase}.hero h1{max-width:780px;margin:18px 0;font-size:clamp(48px,8vw,98px);font-weight:500;line-height:.82;letter-spacing:-.09em}.hero-copy{max-width:580px;margin:0;color:var(--muted);font-size:12px;line-height:1.8}.robot-card{border:1px solid var(--line);background:var(--surface)}.robot-visual{height:190px;display:grid;place-items:center;border-bottom:1px solid var(--line);overflow:hidden;background-image:linear-gradient(var(--line) 1px,transparent 1px),linear-gradient(90deg,var(--line) 1px,transparent 1px);background-size:24px 24px}.robot-face{position:relative;width:156px;height:92px;border:2px solid var(--text);border-radius:50% 50% 42% 42%;background:var(--bg)}.robot-face:before,.robot-face:after{content:"";position:absolute;top:35px;width:13px;height:8px;background:var(--text)}.robot-face:before{left:38px}.robot-face:after{right:38px}.antenna{position:absolute;width:2px;height:30px;background:var(--text);left:76px;top:-31px}.antenna:after{content:"";position:absolute;width:8px;height:8px;border:2px solid var(--text);border-radius:50%;left:-5px;top:-8px;background:var(--bg)}.robot-meta{display:grid;grid-template-columns:1fr auto;gap:12px;padding:15px}.robot-id{font-size:12px;font-weight:700}.connection{display:flex;align-items:center;gap:8px;color:var(--muted);font-size:9px;letter-spacing:.1em;text-transform:uppercase}.connection:before{content:"";width:7px;height:7px;background:currentColor}.connection.online{color:var(--text)}.connection.offline{text-decoration:line-through}
.main-grid{display:grid;grid-template-columns:180px minmax(0,1fr);border-top:1px solid var(--line)}.rail{padding:28px 22px 28px 0;border-right:1px solid var(--line)}.rail-sticky{position:sticky;top:24px}.rail a{display:flex;align-items:center;margin:3px 0;padding:10px;color:var(--muted);font-size:10px;text-decoration:none;transition:background .2s ease,color .2s ease,transform .2s ease}.rail a:hover{color:var(--text);transform:translateX(3px)}.rail a.active{background:var(--text);color:var(--inverse)}.rail a span{display:inline-block;width:32px;color:inherit}.content{min-width:0;padding-left:28px}.section{padding:32px 0 46px;border-bottom:1px solid var(--line);scroll-margin-top:24px}.section-head{display:flex;align-items:flex-start;justify-content:space-between;gap:20px;margin-bottom:24px}.section-title h2{margin:8px 0 0;font-size:22px;font-weight:500;letter-spacing:-.05em}.state{border:1px solid var(--line);padding:8px 10px;color:var(--muted);font-size:9px;letter-spacing:.1em;text-transform:uppercase}
.health-grid{display:grid;grid-template-columns:repeat(4,minmax(0,1fr));border-top:1px solid var(--line);border-left:1px solid var(--line)}.sensor{min-width:0;min-height:112px;padding:14px;border-right:1px solid var(--line);border-bottom:1px solid var(--line);background:var(--surface)}.sensor-top{display:flex;align-items:center;justify-content:space-between}.sensor span{color:var(--muted);font-size:9px;letter-spacing:.08em;text-transform:uppercase}.signal{width:18px;height:2px;background:var(--muted)}.sensor.ok .signal{background:var(--text)}.sensor.warn .signal{background:linear-gradient(90deg,var(--text) 50%,transparent 50%)}.sensor.bad .signal{background:transparent;border-top:2px dotted var(--text)}.sensor b{display:block;margin-top:28px;font-size:12px;white-space:nowrap;overflow:hidden;text-overflow:ellipsis}
.voice-overview{display:grid;grid-template-columns:repeat(3,1fr);border:1px solid var(--line);margin-bottom:12px}.voice-stat{padding:14px;background:var(--surface)}.voice-stat+.voice-stat{border-left:1px solid var(--line)}.voice-stat span{display:block;color:var(--muted);font-size:9px;letter-spacing:.08em;text-transform:uppercase}.voice-stat b{display:block;margin-top:9px;font-size:12px}.terminal{border:1px solid var(--line);background:var(--surface)}.terminal-bar{display:flex;align-items:center;justify-content:space-between;height:42px;padding:0 12px;border-bottom:1px solid var(--line)}.terminal-title{font-size:9px;letter-spacing:.1em;text-transform:uppercase}.terminal-actions{display:flex;gap:8px}.text-button{border:0;background:transparent;color:var(--muted);font-size:9px;letter-spacing:.08em;text-transform:uppercase;cursor:pointer}.text-button:hover{color:var(--text)}.chatlog{height:330px;overflow:auto;padding:8px 12px;font-size:11px;line-height:1.65}.logline{display:grid;grid-template-columns:68px 1fr;gap:12px;padding:7px 0;border-bottom:1px solid var(--line);white-space:pre-wrap}.logline i{font-style:normal;color:var(--muted);font-size:9px;letter-spacing:.08em}.logline.error i{color:var(--text);font-weight:900}.legend{display:flex;gap:18px;flex-wrap:wrap;margin-top:11px;color:var(--muted);font-size:9px}.legend b{color:var(--text)}.explain{margin:16px 0 0;color:var(--muted);font-size:10px;line-height:1.7}.explain strong{color:var(--text)}#logPanel.fullscreen{position:fixed;inset:0;z-index:10;padding:24px;background:var(--bg);display:flex;flex-direction:column}#logPanel.fullscreen .terminal{display:flex;flex:1;flex-direction:column}#logPanel.fullscreen .chatlog{height:auto;flex:1;font-size:13px}
.two-column{display:grid;grid-template-columns:1fr 1fr;gap:14px}.module{border:1px solid var(--line);background:var(--surface);padding:18px}.module-number{color:var(--muted);font-size:9px}.module h3{margin:34px 0 10px;font-size:15px;font-weight:500}.module p{min-height:50px;margin:0;color:var(--muted);font-size:10px;line-height:1.7}.actions{display:flex;gap:8px;align-items:center;flex-wrap:wrap;margin-top:18px}.button{min-height:38px;padding:0 13px;border:1px solid var(--text);background:var(--text);color:var(--inverse);display:inline-flex;align-items:center;text-decoration:none;font-size:9px;font-weight:700;letter-spacing:.06em;text-transform:uppercase;cursor:pointer}.button.secondary{background:transparent;color:var(--text);border-color:var(--line)}details{margin-top:14px;border-top:1px solid var(--line);padding-top:13px;color:var(--muted);font-size:10px}summary{cursor:pointer;color:var(--text)}.credential{width:100%;margin-top:12px;padding:11px;border:1px solid var(--line);background:var(--raised);color:var(--text);font-size:10px;outline:none}.credential:focus{border-color:var(--text)}.code-block{margin-top:15px;padding:13px;background:var(--raised);border-left:2px solid var(--text);font-size:10px;line-height:1.6}.hidden{display:none!important}.footer{display:flex;justify-content:space-between;padding-top:22px;color:var(--muted);font-size:9px;letter-spacing:.08em;text-transform:uppercase}
@media(max-width:900px){.hero{grid-template-columns:1fr 290px;gap:28px}.health-grid{grid-template-columns:repeat(3,1fr)}}
@media(max-width:700px){.page{padding:0 14px 28px}.nav{height:62px}.hero{min-height:0;padding:42px 0 30px;grid-template-columns:1fr}.hero h1{font-size:57px}.robot-card{max-width:none}.main-grid{display:block}.rail{display:none}.content{padding:0}.health-grid{grid-template-columns:repeat(2,1fr)}.voice-overview{grid-template-columns:1fr}.voice-stat+.voice-stat{border-left:0;border-top:1px solid var(--line)}.two-column{grid-template-columns:1fr}.section{padding:28px 0 36px}.logline{grid-template-columns:52px 1fr}.footer{display:block;line-height:2}.nav-link{padding:0 10px}}
.rail a.active{background:transparent;color:var(--text);font-weight:700}
.machine-identity{display:flex;align-items:baseline;gap:.16em}.machine-identity i{font-size:.34em;font-style:normal;font-weight:400;color:var(--muted);letter-spacing:0}.machine-identity span:last-child{font-variant-numeric:tabular-nums;letter-spacing:-.04em}
.theme-cycle{width:38px;height:38px;padding:0;border:1px solid var(--line);background:transparent;color:var(--text);font:700 11px inherit;cursor:pointer}.theme-cycle:hover{background:var(--text);color:var(--inverse);border-color:var(--text)}
</style>
</head>
<body>
<div class="page">
  <nav class="nav">
    <div class="wordmark" aria-label="zautobot">zautobot</div>
    <div class="nav-right">
      <a class="nav-link" href="https://zautobot.com/robots" target="_blank" rel="noopener">ACCOUNT ↗</a>
      <button id="themeCycle" class="theme-cycle" type="button" onclick="cycleTheme()" aria-label="Theme: System" title="Theme: System">A</button>
    </div>
  </nav>

  <header class="hero">
    <div>
      <div class="overline">zautobot / unique machine identity</div>
      <h1 class="machine-identity"><span id="heroRobotSeries">Z2</span><i>/</i><span id="heroRobotNumber">001</span></h1>
      <p class="hero-copy">One robot. One registered identity. Use this local interface to inspect its hardware, trace its voice system, connect its account, and maintain its firmware.</p>
    </div>
    <div class="robot-card">
      <div class="robot-visual" aria-hidden="true"><div class="robot-face"><i class="antenna"></i></div></div>
      <div class="robot-meta"><div><div class="label">Machine</div><div class="robot-id"><span id="robotHost">robot-id</span>.local</div></div><div id="connection" class="connection">Connecting</div></div>
    </div>
  </header>

  <div class="main-grid">
    <aside class="rail"><div class="rail-sticky"><div class="overline">Index</div><a href="#hardware"><span>01</span>Hardware</a><a href="#voice"><span>02</span>Logs</a><a href="#setup"><span>03</span>Setup</a><a href="#firmware"><span>04</span>Firmware</a></div></aside>
    <main class="content">
      <section id="hardware" class="section">
        <div class="section-head"><div class="section-title"><div class="section-index">01 / Hardware</div><h2>Machine health</h2></div><span id="healthSummary" class="state">Scanning</span></div>
        <div class="health-grid">
          <div id="healthWifi" class="sensor"><div class="sensor-top"><span>Wi-Fi</span><i class="signal"></i></div><b>Checking</b></div>
          <div id="healthMotor" class="sensor"><div class="sensor-top"><span>Motors</span><i class="signal"></i></div><b>Checking</b></div>
          <div id="healthSonar" class="sensor"><div class="sensor-top"><span>Front sonar</span><i class="signal"></i></div><b>Checking</b></div>
          <div id="healthTofLeft" class="sensor"><div class="sensor-top"><span>Front left</span><i class="signal"></i></div><b>Checking</b></div>
          <div id="healthTofRight" class="sensor"><div class="sensor-top"><span>Front right</span><i class="signal"></i></div><b>Checking</b></div>
          <div id="healthTofBack" class="sensor"><div class="sensor-top"><span>Rear distance</span><i class="signal"></i></div><b>Checking</b></div>
          <div id="healthCliffLeft" class="sensor"><div class="sensor-top"><span>Cliff left</span><i class="signal"></i></div><b>Checking</b></div>
          <div id="healthCliffRight" class="sensor"><div class="sensor-top"><span>Cliff right</span><i class="signal"></i></div><b>Checking</b></div>
          <div id="healthLight" class="sensor"><div class="sensor-top"><span>Ambient light</span><i class="signal"></i></div><b>Checking</b></div>
          <div id="healthMic" class="sensor"><div class="sensor-top"><span>Microphone</span><i class="signal"></i></div><b>Checking</b></div>
          <div id="healthAudio" class="sensor"><div class="sensor-top"><span>Speaker</span><i class="signal"></i></div><b>Checking</b></div>
          <div id="healthLed" class="sensor"><div class="sensor-top"><span>Light ring</span><i class="signal"></i></div><b>Checking</b></div>
        </div>
      </section>

      <section id="voice" class="section">
        <div class="section-head"><div class="section-title"><div class="section-index">02 / Diagnostics</div><h2>System log</h2></div><span id="chatBadge" class="state">Checking</span></div>
        <div class="voice-overview"><div class="voice-stat"><span>Wake phrase</span><b id="wakeWord">—</b></div><div class="voice-stat"><span>Microphone</span><b id="chatVoice">Monitoring</b></div><div class="voice-stat"><span>System state</span><b id="chatState">—</b></div></div>
        <div id="logPanel" class="terminal"><div class="terminal-bar"><div class="terminal-title">Live machine log</div><div class="terminal-actions"><button id="fullLogButton" class="text-button" onclick="toggleFullLog()">Full screen</button></div></div><div id="chatLog" class="chatlog">Waiting for robot events…</div></div>
        <div class="legend"><span><b>STATE</b> conversation</span><span><b>API</b> WebSocket</span><span><b>AUDIO</b> microphone / speaker</span><span><b>ERROR</b> system failure</span></div>
        <p class="explain"><strong>How to read this:</strong> WAKE_LISTENING means the robot is connected and listening locally. RECORDING sends microphone audio. WAITING means the system is preparing an answer. SPEAKING means audio is playing.</p>
      </section>

      <section id="setup" class="section">
        <div class="section-head"><div class="section-title"><div class="section-index">03 / Setup</div><h2>Connect the robot</h2></div><span id="setupStep" class="state">Checking</span></div>
        <div class="two-column">
          <article class="module"><div class="module-number">01 / Network</div><h3>Local Wi-Fi</h3><p id="wifiSetupCopy">Connect the robot to your network. Credentials stay on the robot and are never shown here.</p><div class="actions"><button class="button secondary" onclick="startWifiSetup()">Change Wi-Fi</button></div></article>
          <article class="module"><div class="module-number">02 / Ownership</div><h3>zautobot account</h3><p id="onboardStatus">Checking account connection…</p><div class="actions"><a id="robotCloudLink" class="button" href="https://zautobot.com/robots" target="_blank" rel="noopener">Connect account ↗</a></div><details id="developerCredential" class="hidden"><summary>Install a device credential</summary><input id="robotToken" class="credential" type="password" autocomplete="off" placeholder="Paste rk_ device credential"><div class="actions"><button class="button secondary" onclick="saveRobotToken()">Finish connection</button></div></details></article>
        </div>
      </section>

      <section id="firmware" class="section">
        <div class="section-head"><div class="section-title"><div class="section-index">04 / Firmware</div><h2>System maintenance</h2></div><span id="otaBadge" class="state">Checking</span></div>
        <div class="two-column"><article class="module"><div class="module-number">Status</div><h3>Update readiness</h3><p id="otaStatus">Checking OTA availability…</p></article><article class="module"><div class="module-number">Developer command</div><h3>Install an update</h3><p>Automatic signed account updates are not enabled yet. Use the local development command on your Mac.</p><div class="code-block">$ ./z2.sh ota</div></article></div>
      </section>
    </main>
  </div>
  <footer class="footer"><span id="footerHost">robot-id.local</span><span>Local diagnostics / Safety remains on-device</span></footer>
</div>
<script>
const $=s=>document.querySelector(s),connection=$('#connection');
const themeMedia=matchMedia('(prefers-color-scheme:dark)'),themePreference=localStorage.getItem('zautobot-theme')||'system';
function applyTheme(preference){const theme=preference==='system'?(themeMedia.matches?'dark':'light'):preference,button=$('#themeCycle'),labels={system:['A','System'],light:['☼','Light'],dark:['☾','Dark']};document.documentElement.dataset.theme=theme;document.querySelector('meta[name="theme-color"]').content=theme==='dark'?'#050505':'#f7f7f5';button.textContent=labels[preference][0];button.setAttribute('aria-label','Theme: '+labels[preference][1]+'. Select next theme');button.title='Theme: '+labels[preference][1]}
function setThemePreference(preference){localStorage.setItem('zautobot-theme',preference);applyTheme(preference)}
function cycleTheme(){const order=['system','light','dark'],current=localStorage.getItem('zautobot-theme')||'system';setThemePreference(order[(order.indexOf(current)+1)%order.length])}
themeMedia.addEventListener('change',()=>{if((localStorage.getItem('zautobot-theme')||'system')==='system')applyTheme('system')});applyTheme(themePreference);
const indexLinks=[...document.querySelectorAll('.rail a')];
indexLinks.forEach(link=>link.addEventListener('click',event=>{event.preventDefault();document.querySelector(link.getAttribute('href')).scrollIntoView({behavior:'smooth',block:'start'})}));
const sectionObserver=new IntersectionObserver(entries=>{const visible=entries.filter(entry=>entry.isIntersecting).sort((a,b)=>b.intersectionRatio-a.intersectionRatio)[0];if(!visible)return;indexLinks.forEach(link=>{const active=link.getAttribute('href')==='#'+visible.target.id;link.classList.toggle('active',active);if(active)link.setAttribute('aria-current','location');else link.removeAttribute('aria-current')})},{rootMargin:'-12% 0px -62% 0px',threshold:[0,.15,.35]});
document.querySelectorAll('.section').forEach(section=>sectionObserver.observe(section));
function connected(ok){connection.className='connection '+(ok?'online':'offline');connection.textContent=ok?'Connected':'Offline'}
function card(id,state,text){const e=$('#health'+id);e.className='sensor '+state;e.querySelector('b').textContent=text}
let robotHealth={};
async function updateHealth(){try{const d=await(await fetch('/health',{cache:'no-store'})).json();robotHealth=d;connected(true);card('Wifi',d.wifi?'ok':'bad',d.wifi?'Connected':'Offline');card('Motor',!d.power?'warn':d.cliffRecovery?'warn':'ok',!d.power?'Power off':d.cliffRecovery?'Cliff recovery':'Ready');card('Sonar',d.sonar?'ok':'bad',d.sonar?d.distance.toFixed(1)+' cm':'No echo');card('TofLeft',d.tofLeft?'ok':d.tofLeftReady?'warn':'bad',d.tofLeft?d.leftType+' · '+d.leftMm+' mm':d.tofLeftReady?'Out of range':'Init failed');card('TofRight',d.tofRight?'ok':d.tofRightReady?'warn':'bad',d.tofRight?d.rightType+' · '+d.rightMm+' mm':d.tofRightReady?'Out of range':'Init failed');card('TofBack',d.tofBack?'ok':d.tofBackReady?'warn':'bad',d.tofBack?d.backType+' · '+d.backMm+' mm':d.tofBackReady?'Out of range':'Init failed');card('CliffLeft',d.cliffLeft?'bad':'ok',d.cliffLeft?'Edge detected':'Safe floor');card('CliffRight',d.cliffRight?'bad':'ok',d.cliffRight?'Edge detected':'Safe floor');card('Light',d.light?'ok':'bad',d.light?d.lux.toFixed(0)+' lux':'Not found');card('Mic',d.mic?'ok':'bad',d.mic?'Ready':'Unavailable');card('Audio',d.audio?'ok':'bad',d.audio?'Ready':'Unavailable');card('Led',d.power?'ok':'warn',d.power?d.ringMode+' · '+d.ringBrightness:'Off');$('#otaBadge').textContent=d.otaReady?'Ready':d.wifi?'Waiting':'Offline';$('#otaStatus').innerHTML=d.otaReady?'<strong>OTA ready · firmware '+d.firmwareVersion+'</strong><br>The robot can receive development updates on this Wi-Fi.':d.wifi?'<strong>Wi-Fi connected · firmware '+d.firmwareVersion+'</strong><br>Waiting for a device-scoped update credential.':'<strong>Wi-Fi required</strong><br>Complete local setup before enabling OTA.';const problems=[!d.wifi,!d.sonar,!d.tofLeftReady,!d.tofRightReady,!d.tofBackReady,d.cliffLeft,d.cliffRight].filter(Boolean).length;$('#healthSummary').textContent=problems?problems+' need attention':'All systems ready'}catch(_){connected(false);$('#healthSummary').textContent='Unavailable'}}
let lastLog='';
function logKind(line){const lower=line.toLowerCase();if(lower.includes('error')||lower.includes('failed')||lower.includes('disconnected'))return['error','ERROR'];if(lower.includes('audio')||lower.includes('recording')||lower.includes('speaker')||lower.includes('heard:'))return['audio','AUDIO'];if(lower.includes('api event')||lower.includes('websocket')||lower.includes('api connected'))return['api','API'];return['state','STATE']}
function renderLog(entries){const box=$('#chatLog');box.innerHTML='';if(!entries.length){box.textContent='Waiting for robot events…';return}entries.forEach(line=>{const kind=logKind(line),row=document.createElement('div'),tag=document.createElement('i'),text=document.createElement('span');row.className='logline '+kind[0];tag.textContent=kind[1];text.textContent=line;row.append(tag,text);box.append(row)});box.scrollTop=box.scrollHeight}
function toggleFullLog(){const panel=$('#logPanel'),on=!panel.classList.contains('fullscreen');panel.classList.toggle('fullscreen',on);$('#fullLogButton').textContent=on?'Exit full screen':'Full screen';if(on&&panel.requestFullscreen)panel.requestFullscreen().catch(()=>{});else if(!on&&document.fullscreenElement)document.exitFullscreen().catch(()=>{})}
document.addEventListener('fullscreenchange',()=>{if(!document.fullscreenElement){$('#logPanel').classList.remove('fullscreen');$('#fullLogButton').textContent='Full screen'}});
async function updateLog(){try{const d=await(await fetch('/chatlog',{cache:'no-store'})).json(),id=d.robot_id||'robot-id',name=id.toUpperCase(),parts=name.split('-');$('#heroRobotSeries').textContent=parts.shift()||'UNIT';$('#heroRobotNumber').textContent=parts.join('-')||name;$('#robotHost').textContent=id;$('#footerHost').textContent=id+'.local';document.title=name+' / zautobot system';$('#robotCloudLink').href='https://zautobot.com/robots/'+encodeURIComponent(id);$('#wakeWord').textContent=d.wake_word||'—';$('#chatState').textContent=d.state;$('#chatVoice').textContent=d.voice?'Voice detected':'Monitoring';$('#chatBadge').textContent=d.configured?'API connected':'Setup required';$('#developerCredential').classList.toggle('hidden',d.config_synced);$('#setupStep').textContent=d.config_synced?'Complete':robotHealth.wifi?'Step 2 / 2':'Step 1 / 2';$('#robotCloudLink').textContent=d.config_synced?'Manage account ↗':'Connect account ↗';$('#onboardStatus').innerHTML=d.config_synced?'Wi-Fi and account ownership are connected.':robotHealth.wifi?'Wi-Fi is ready. Connect this robot to your account.':'Connect Wi-Fi first, then link account ownership.';const signature=d.entries.join('\n');if(signature!==lastLog){renderLog(d.entries);lastLog=signature}}catch(_){$('#chatBadge').textContent='Unavailable'}}
async function saveRobotToken(){const token=$('#robotToken').value.trim();if(!token.startsWith('rk_')){alert('Credential must start with rk_');return}const r=await fetch('/robot/credential',{method:'POST',headers:{'Content-Type':'application/json'},body:JSON.stringify({device_token:token})});if(r.ok){$('#robotToken').value='';updateLog()}else alert('Credential rejected')}
async function startWifiSetup(){if(!confirm('Restart the robot in Wi-Fi setup mode? The current network stays saved until a new one connects.'))return;const r=await fetch('/setup/start',{method:'POST'});if(r.ok)alert('The robot is restarting. Scan the QR code on its OLED.');else alert('Could not start Wi-Fi setup.')}
updateHealth();updateLog();setInterval(updateHealth,1000);setInterval(updateLog,500);
</script>
</body>
</html>
)HTML";
